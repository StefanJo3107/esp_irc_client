## main/Kconfig.projbuild
```kconfig
menu "IRC Configuration"
    choice SOCKET_IP_INPUT
        prompt "Socket input source"
        default SOCKET_INPUT_STRING
        help
            Selects the input source of the IP address
        config SOCKET_IP_INPUT_STRING
            bool "From string"
        config SOCKET_IP_INPUT_STDIN
            bool "From stdin"
    endchoice

    choice IP_MODE
        prompt "IP Version"
        depends on SOCKET_IP_INPUT_STRING
        help
            Is the address IPV4 or IPV6
        config IPV4
            bool "IPV4"
        config IPV6
            bool "IPV6"
    endchoice

    config IPV4_ADDR
        string "IPV4 Address"
        default "192.168.0.165"
        depends on IPV4
        help
            IPV4 address the client will connect to

    config IPV6_ADDR
        string "IPV6 Address"
        default "FE80::30AD::E57B::C212::68AD"
        depends on IPV6
        help
            IPV6 address the client will connect to

    config PORT
        int "Port"
        range 0 65535
        default 6697
        help
            The remote port to which the client will connect to

    choice INTERFACE
        prompt "Interface selection"
        depends on IPV6
        help
            Interface can be either "Auto" or "User specified"
        config IFACE_AUTO
            bool "Auto"
        config IFACE_USER
            bool "User specified interface"
    endchoice

    config IFACE_USER_NAME
        string "User specified interface name"
        default "st1"
        depends on IFACE_USER
        help
            This interface will be used for communication
endmenu
```
